## meta-iot2000-custom/conf/layer.conf
```bitbake
# We have a conf and classes directory, add to BBPATH
BBPATH .= ":${LAYERDIR}"

# We have a recipes-* directories, add to BBFILES
BBFILES += "${LAYERDIR}/recipes-*/*/*.bb \
	${LAYERDIR}/recipes-*/*/*.bbappend"

BBFILE_COLLECTIONS += "iot2000-custom"
BBFILE_PATTERN_iot2000-custom = "^${LAYERDIR}/"
BBFILE_PRIORITY_iot2000-custom = "6"

LAYERDEPENDS_iot2000-custom += " \
	iot2000-bsp \
	"

LAYERSERIES_COMPAT_iot2000-custom = "dunfell"

IOT2000_MIT_LICENSE = "${LAYERDIR}/COPYING.MIT"
IOT2000_GPLv2_LICENSE = "${LAYERDIR}/COPYING.GPLv2"

BB_SIGNATURE_HANDLER = "OEBasicHash"

#set default root password
#First on host, create the (escaped) password hash:
#printf "%q" $(mkpasswd -m sha256crypt put_password_here)
#paste result to "PASSWD"

PASSWD="\$5\$gMw8ENYCZdkYYijv\$0dRl7ikDIBwhD2yvVssOpUrQI67UNHynuP8y07J9wVA"
INHERIT += "extrausers"
EXTRA_USERS_PARAMS = "usermod -p '${PASSWD}' root;"
```
